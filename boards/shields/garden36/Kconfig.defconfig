## boards/shields/garden36/Kconfig.defconfig
```kconfig
if SHIELD_GARDEN36_LEFT

config ZMK_KEYBOARD_NAME
    default "garden36"

config ZMK_SPLIT_ROLE_CENTRAL
    default y

endif

if SHIELD_GARDEN36_LEFT || SHIELD_GARDEN36_RIGHT

config ZMK_SPLIT
    default y

endif
```

## boards/shields/garden36/Kconfig.shield
```kconfig
config SHIELD_GARDEN36_LEFT
    def_bool $(shields_list_contains,garden36_left)

config SHIELD_GARDEN36_RIGHT
    def_bool $(shields_list_contains,garden36_right)
```
